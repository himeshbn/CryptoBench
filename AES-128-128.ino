/*
  ESP32 AES-128-128 Benchmark (No External Library) - with Decryption
  ------------------------------------------------------------------
  - Pure C/C++ AES-128 implementation (FIPS-197)
  - Adds AES decryption (InvSubBytes, InvShiftRows, InvMixColumns)
  - Measures key schedule, encryption, decryption
  - Toggles TRIG_PIN (GPIO4) for UNO+INA219 power logger
  - Prints CSV per-run and summary stats to Serial Monitor
  - Author:  
*/

#include <Arduino.h>
#include "esp_timer.h"
#include "WiFi.h"
#include "BluetoothSerial.h"
#include <math.h>

// ===== USER CONFIG =====
const uint32_t CPU_FREQ_HZ = 240000000UL;
const int TRIG_PIN = 4;          // GPIO4 → UNO D2
const uint32_t N_RUNS  = 20;
const uint32_t N_LOOPS = 200000;
const size_t BLOCK_BYTES = 16;
const size_t KEY_BYTES   = 16;
// ========================

// ---------- AES CONSTANTS ----------
static const uint8_t sbox[256] = {
  0x63,0x7c,0x77,0x7b,0xf2,0x6b,0x6f,0xc5,0x30,0x01,0x67,0x2b,0xfe,0xd7,0xab,0x76,
  0xca,0x82,0xc9,0x7d,0xfa,0x59,0x47,0xf0,0xad,0xd4,0xa2,0xaf,0x9c,0xa4,0x72,0xc0,
  0xb7,0xfd,0x93,0x26,0x36,0x3f,0xf7,0xcc,0x34,0xa5,0xe5,0xf1,0x71,0xd8,0x31,0x15,
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  0x8c,0xa1,0x89,0x0d,0xbf,0xe6,0x42,0x68,0x41,0x99,0x2d,0x0f,0xb0,0x54,0xbb,0x16
};

static const uint8_t invsbox[256] = {
  0x52,0x09,0x6A,0xD5,0x30,0x36,0xA5,0x38,0xBF,0x40,0xA3,0x9E,0x81,0xF3,0xD7,0xFB,
  0x7C,0xE3,0x39,0x82,0x9B,0x2F,0xFF,0x87,0x34,0x8E,0x43,0x44,0xC4,0xDE,0xE9,0xCB,
  0x54,0x7B,0x94,0x32,0xA6,0xC2,0x23,0x3D,0xEE,0x4C,0x95,0x0B,0x42,0xFA,0xC3,0x4E,
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  0x17,0x2B,0x04,0x7E,0xBA,0x77,0xD6,0x26,0xE1,0x69,0x14,0x63,0x55,0x21,0x0C,0x7D
};

static const uint8_t Rcon[11] = {
  0x00,0x01,0x02,0x04,0x08,0x10,0x20,0x40,0x80,0x1B,0x36
};

// ---------- AES UTILS ----------
void KeyExpansion(uint8_t *RoundKey, const uint8_t *Key) {
  uint8_t temp[4];
  int i = 0;
  while (i < 16) { RoundKey[i] = Key[i]; i++; }
  int bytesGenerated = 16; int rconIter = 1;
  uint8_t k;
  while (bytesGenerated < 176) {
    for (int j = 0; j < 4; j++) temp[j] = RoundKey[bytesGenerated - 4 + j];
    if (bytesGenerated % 16 == 0) {
      k = temp[0]; temp[0] = temp[1]; temp[1] = temp[2]; temp[2] = temp[3]; temp[3] = k;
      temp[0] = sbox[temp[0]]; temp[1] = sbox[temp[1]]; temp[2] = sbox[temp[2]]; temp[3] = sbox[temp[3]];
      temp[0] ^= Rcon[rconIter++];
    }
    for (uint8_t j = 0; j < 4; j++) {
      RoundKey[bytesGenerated] = RoundKey[bytesGenerated - 16] ^ temp[j];
      bytesGenerated++;
    }
  }
}

uint8_t xtime(uint8_t x){ return ((x<<1)^(((x>>7)&1)*0x1b)); }

void SubBytes(uint8_t* state){ for(int i=0;i<16;i++) state[i]=sbox[state[i]]; }
void ShiftRows(uint8_t* s){
  uint8_t temp;
  // Row 1
  temp = s[1]; s[1]=s[5]; s[5]=s[9]; s[9]=s[13]; s[13]=temp;
  // Row 2
  temp = s[2]; uint8_t temp2=s[6]; s[2]=s[10]; s[6]=s[14]; s[10]=temp; s[14]=temp2;
  // Row 3
  temp = s[3]; s[3]=s[15]; s[15]=s[11]; s[11]=s[7]; s[7]=temp;
}
void MixColumns(uint8_t* s){
  uint8_t Tmp,Tm,t;
  for(int i=0;i<4;i++){
    t=s[i*4+0]; Tmp=s[i*4+0]^s[i*4+1]^s[i*4+2]^s[i*4+3];
    Tm=s[i*4+0]^s[i*4+1]; Tm=xtime(Tm); s[i*4+0]^=Tm^Tmp;
    Tm=s[i*4+1]^s[i*4+2]; Tm=xtime(Tm); s[i*4+1]^=Tm^Tmp;
    Tm=s[i*4+2]^s[i*4+3]; Tm=xtime(Tm); s[i*4+2]^=Tm^Tmp;
    Tm=s[i*4+3]^t; Tm=xtime(Tm); s[i*4+3]^=Tm^Tmp;
  }
}
void AddRoundKey(uint8_t* state,const uint8_t* RoundKey,int round){
  for(int i=0;i<16;i++) state[i]^=RoundKey[round*16+i];
}

void AES_Encrypt(uint8_t* input, const uint8_t* RoundKey){
  uint8_t state[16]; memcpy(state,input,16);
  AddRoundKey(state,RoundKey,0);
  for(int round=1;round<=9;round++){
    SubBytes(state); ShiftRows(state); MixColumns(state); AddRoundKey(state,RoundKey,round);
  }
  SubBytes(state); ShiftRows(state); AddRoundKey(state,RoundKey,10);
  memcpy(input,state,16);
}

// ---------- AES Decryption helpers ----------
static inline uint8_t gmul(uint8_t a, uint8_t b) {
  uint8_t p = 0;
  for (int i = 0; i < 8; i++) {
    if (b & 1) p ^= a;
    uint8_t hi_bit = (a & 0x80);
    a <<= 1;
    if (hi_bit) a ^= 0x1b;
    b >>= 1;
  }
  return p;
}

void InvSubBytes(uint8_t* state){ for(int i=0;i<16;i++) state[i]=invsbox[state[i]]; }

void InvShiftRows(uint8_t* s){
  uint8_t temp;
  // Row1 rotate right by 1
  temp = s[13]; s[13]=s[9]; s[9]=s[5]; s[5]=s[1]; s[1]=temp;
  // Row2 rotate right by 2
  temp = s[2]; s[2]=s[10]; s[10]=temp; temp = s[6]; s[6]=s[14]; s[14]=temp;
  // Row3 rotate right by 3
  temp = s[3]; s[3]=s[7]; s[7]=s[11]; s[11]=s[15]; s[15]=temp;
}

void InvMixColumns(uint8_t* s){
  for (int i = 0; i < 4; i++) {
    uint8_t a0 = s[i*4+0], a1 = s[i*4+1], a2 = s[i*4+2], a3 = s[i*4+3];
    s[i*4+0] = gmul(a0,0x0e)^gmul(a1,0x0b)^gmul(a2,0x0d)^gmul(a3,0x09);
    s[i*4+1] = gmul(a0,0x09)^gmul(a1,0x0e)^gmul(a2,0x0b)^gmul(a3,0x0d);
    s[i*4+2] = gmul(a0,0x0d)^gmul(a1,0x09)^gmul(a2,0x0e)^gmul(a3,0x0b);
    s[i*4+3] = gmul(a0,0x0b)^gmul(a1,0x0d)^gmul(a2,0x09)^gmul(a3,0x0e);
  }
}

void AES_Decrypt(uint8_t* input, const uint8_t* RoundKey) {
  uint8_t state[16]; memcpy(state,input,16);
  AddRoundKey(state,RoundKey,10);
  for (int round = 9; round >= 1; round--) {
    InvShiftRows(state);
    InvSubBytes(state);
    AddRoundKey(state,RoundKey,round);
    InvMixColumns(state);
  }
  InvShiftRows(state);
  InvSubBytes(state);
  AddRoundKey(state,RoundKey,0);
  memcpy(input,state,16);
}

// ---------- Benchmark helpers ----------
double ks_times_us[20], enc_times_us[20], dec_times_us[20];
inline void trig_high(){digitalWrite(TRIG_PIN,HIGH);}
inline void trig_low(){digitalWrite(TRIG_PIN,LOW);}
void compute_stats(const double *vals,uint32_t n,double &mean,double &sd){
  if(n==0){mean=sd=0;return;} double sum=0;for(uint32_t i=0;i<n;i++)sum+=vals[i];
  mean=sum/n;if(n==1){sd=0;return;}double s=0;for(uint32_t i=0;i<n;i++)s+=pow(vals[i]-mean,2);
  sd=sqrt(s/(n-1));
}

// ---------- Setup ----------
void setup(){
  Serial.begin(115200); delay(1000);
  WiFi.mode(WIFI_OFF); btStop();
  pinMode(TRIG_PIN,OUTPUT); digitalWrite(TRIG_PIN,LOW);
  delay(2000);
  Serial.println("# AES-128-128 ESP32 Benchmark (No Library) - with Decrypt");
  Serial.printf("# CPU=%.2f MHz, N_RUNS=%u, N_LOOPS=%u\n",CPU_FREQ_HZ/1e6,N_RUNS,N_LOOPS);
  Serial.println("ALG,key_bits,block_bits,run,N_loops,ks_us,enc_us,dec_us,throughput_Bps,cycles_per_block");
}

// ---------- Main ----------
void loop(){
  uint8_t key[16]={0x2b,0x7e,0x15,0x16,0x28,0xae,0xd2,0xa6,0xab,0xf7,0x97,0x75,0x46,0x20,0x63,0xed};
  uint8_t plain[16]={0x32,0x43,0xf6,0xa8,0x88,0x5a,0x30,0x8d,0x31,0x31,0x98,0xa2,0xe0,0x37,0x07,0x34};
  uint8_t RoundKey[176];
  uint8_t block[16];

  for(uint32_t run=0;run<N_RUNS;run++){
    // Measure key schedule by repeating KeyExpansion N_LOOPS times (keeps same semantics as before)
    trig_high();
    uint64_t ks_start = esp_timer_get_time();
    for(uint32_t i=0;i<N_LOOPS;i++) KeyExpansion(RoundKey,key);
    uint64_t ks_us = esp_timer_get_time() - ks_start;
    trig_low(); ks_times_us[run]=ks_us;
    delay(50);

    // Prepare RoundKey once for enc/dec loops (deterministic)
    KeyExpansion(RoundKey,key);

    // Encryption timing
    trig_high();
    uint64_t enc_start = esp_timer_get_time();
    for(uint32_t i=0;i<N_LOOPS;i++){
      memcpy(block,plain,16);
      AES_Encrypt(block,RoundKey);
    }
    uint64_t enc_us = esp_timer_get_time() - enc_start;
    trig_low(); enc_times_us[run]=enc_us;
    delay(50);

    // Decryption timing
    trig_high();
    uint64_t dec_start = esp_timer_get_time();
    for(uint32_t i=0;i<N_LOOPS;i++){
      memcpy(block,plain,16);
      // to ensure we measure a true decrypt, first encrypt a temp then decrypt it
      AES_Encrypt(block,RoundKey);   // now block holds ciphertext
      AES_Decrypt(block,RoundKey);   // decrypt back
      // we don't check contents here to avoid interfering with timing
    }
    uint64_t dec_us = esp_timer_get_time() - dec_start;
    trig_low(); dec_times_us[run]=dec_us;
    delay(200);

    // compute per-run metrics (using encryption time for throughput)
    double enc_s = enc_us/1e6;
    double throughput = (BLOCK_BYTES*(double)N_LOOPS)/enc_s;
    double cycles = (CPU_FREQ_HZ*enc_s)/N_LOOPS;

    Serial.printf("AES-128-128,128,128,%u,%u,%.3f,%.3f,%.3f,%.3f,%.3f\n",
      run+1,N_LOOPS,(double)ks_us,(double)enc_us,(double)dec_us,throughput,cycles);
  }

  double ks_mean,ks_sd,enc_mean,enc_sd,dec_mean,dec_sd;
  compute_stats(ks_times_us,N_RUNS,ks_mean,ks_sd);
  compute_stats(enc_times_us,N_RUNS,enc_mean,enc_sd);
  compute_stats(dec_times_us,N_RUNS,dec_mean,dec_sd);

  double enc_s_mean = enc_mean/1e6;
  double throughput_mean = (BLOCK_BYTES*N_LOOPS)/enc_s_mean;
  double cycles_mean = (CPU_FREQ_HZ*enc_s_mean)/N_LOOPS;

  Serial.println("# SUMMARY");
  Serial.printf("# KS mean=%.3fus ±%.3f\n",ks_mean,ks_sd);
  Serial.printf("# ENC mean=%.3fus ±%.3f\n",enc_mean,enc_sd);
  Serial.printf("# DEC mean=%.3fus ±%.3f\n",dec_mean,dec_sd);
  Serial.printf("# Throughput=%.3f B/s, Cycles/block=%.3f\n",throughput_mean,cycles_mean);

  Serial.println("ALG,key_bits,block_bits,N_runs,N_loops,enc_mean_us,enc_sd_us,dec_mean_us,dec_sd_us,throughput_Bps,cycles_per_block");
  Serial.printf("AES-128-128,128,128,%u,%u,%.3f,%.3f,%.3f,%.3f,%.3f,%.3f\n",
    N_RUNS,N_LOOPS,enc_mean,enc_sd,dec_mean,dec_sd,throughput_mean,cycles_mean);

  Serial.println("# BENCHMARK COMPLETE - Halting.");
  while(true) delay(1000);
}
